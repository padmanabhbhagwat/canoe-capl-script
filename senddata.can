/*@!Encoding:1252*/
//The includes section is used to include libraries in the CAPL Script. We are not using any for this basic functionality for sending a message.
includes
{
  
}
//This section is to define the variables inside your script. Either you can create a variable or select a variable from your database.
//Learn CAN for more info on the identifiers. Here I have used the message identifier '0x100' from my database
variables
{
  message 0x100 m1;
}
//Declared the message 0x100 as a global variable m1 for ease.

//on start is a 'event' in the system that will execute the snippet when the script is running.
on start
{
//write is a similar function to printf which will print onto the write window in CANoe.
  write("Sending Data");
}

//on key <newKey> is an event that will execute the snippet when the defined key is pressed. (in this case '1').
on key '1'
{
//.CAN is used to assign a channel number to the message which is set in the simulation setup. Here we are using channel no. 1.
  m1.CAN=1;
//learn about rtr bit in CAN.
  m1.rtr=0;
//dir is used to define whether the message is Tx or Rx.
  m1.dir=1;
//dlc is data length code and it is used to specify length of our data. (Here it is of two bytes).
  m1.dlc=2;
//byte() is an inbuilt function used to assign the byte no. in your data any value that we want which is on the right.
  m1.byte(0)=0x19;
  m1.byte(1)=0x20;
//output is used to print the CAN message m1 on the write window.
  output(m1);
}
